## CMakeLists.txt
```
cmake_minimum_required(VERSION 3.20.0)
find_package(Zephyr REQUIRED HINTS $ENV{ZEPHYR_BASE})

project(pwm_blink)

target_sources(app PRIVATE src/main.c)
```

## prj.conf
```kconfig
CONFIG_PWM=y
CONFIG_LOG=y
CONFIG_LOG_DEFAULT_LEVEL=3
CONFIG_UART_CONSOLE=y
CONFIG_PRINTK=y
```

## boards/nrf5340dk_nrf5340_cpuapp.overlay
```dts
/ {
    aliases {
        pwm-led0 = &pwm_led0;
    };
};

&pwm0 {
    status = "okay";
};
```

## src/main.c
```c
#include <zephyr/kernel.h>
#include <zephyr/device.h>
#include <zephyr/drivers/pwm.h>
#include <zephyr/logging/log.h>

LOG_MODULE_REGISTER(pwm_blink, LOG_LEVEL_INF);

#define PWM_LED_NODE DT_ALIAS(pwm_led0)
#define PWM_PERIOD   PWM_MSEC(20U)
#define STEP_COUNT   100
#define STEP_DELAY   10

static const struct pwm_dt_spec pwm_led = PWM_DT_SPEC_GET(PWM_LED_NODE);

int main(void)
{
    if (!pwm_is_ready_dt(&pwm_led)) {
        LOG_ERR("PWM device not ready");
        return -1;
    }

    LOG_INF("PWM breathing effect starting...");

    uint32_t pulse;

    while (1) {
        for (int i = 0; i <= STEP_COUNT; i++) {
            pulse = (PWM_PERIOD / STEP_COUNT) * i;
            pwm_set_dt(&pwm_led, PWM_PERIOD, pulse);
            k_msleep(STEP_DELAY);
        }

        for (int i = STEP_COUNT; i >= 0; i--) {
            pulse = (PWM_PERIOD / STEP_COUNT) * i;
            pwm_set_dt(&pwm_led, PWM_PERIOD, pulse);
            k_msleep(STEP_DELAY);
        }
    }

    return 0;
}
```
